/* Copyright (c) 2016, The Linux Foundation. All rights reserved.
 *
 * This program is free software; you can redistribute it and/or modify
 * it under the terms of the GNU General Public License version 2 and
 * only version 2 as published by the Free Software Foundation.
 *
 * This program is distributed in the hope that it will be useful,
 * but WITHOUT ANY WARRANTY; without even the implied warranty of
 * MERCHANTABILITY or FITNESS FOR A PARTICULAR PURPOSE.  See the
 * GNU General Public License for more details.
 */

qcom,scud_3200mah {
	qcom,max-voltage-uv = <4400000>;
	qcom,fg-cc-cv-threshold-mv = <4385>;
	qcom,nom-batt-capacity-mah = <3200>;
	qcom,fastchg-current-ma = <2150>;
	qcom,batt-id-kohm = <180>;
	qcom,battery-beta = <3800>;
	qcom,battery-type = "scud_3200mah";
	qcom,checksum = <0xA81E>;
	qcom,gui-version = "PMI8998GUI - 2.0.0.54";
	qcom,fg-profile-data = [
		 B9 1F 55 05
		 B6 0A 0A 06
		 50 1D 53 D3
		 6B 0A E2 15
		 78 18 D5 22
		 D8 45 39 52
		 5B 00 00 00
		 11 00 00 00
		 00 00 E8 C4
		 40 CC A0 CA
		 2E 00 08 00
		 8E EA C6 EC
		 CB FD 4D DB
		 C3 FA 39 12
		 BB EC AB 33
		 19 06 09 20
		 27 00 14 00
		 41 20 E7 04
		 FA 0A D2 05
		 2C 1D 58 01
		 FE E5 E1 04
		 7B 19 83 22
		 F6 45 39 52
		 58 00 00 00
		 0C 00 00 00
		 00 00 A3 CC
		 6F BB 27 B2
		 27 00 00 00
		 7D 00 C6 EC
		 26 F4 04 D3
		 1B EA 11 0A
		 E7 03 9E 1A
		 AD 33 CC FF
		 07 10 00 00
		 81 0C 66 46
		 27 00 40 00
		 67 01 0A FA
		 FF 00 00 00
		 00 00 00 00
		 00 00 00 00
		 00 00 00 00
		 00 00 00 00
		 00 00 00 00
		 00 00 00 00
		 00 00 00 00
		 00 00 00 00
		 00 00 00 00
		 00 00 00 00
		 00 00 00 00
		 00 00 00 00
		 00 00 00 00
		 00 00 00 00
		 00 00 00 00
		 00 00 00 00
		 00 00 00 00
		 00 00 00 00
	];
};
