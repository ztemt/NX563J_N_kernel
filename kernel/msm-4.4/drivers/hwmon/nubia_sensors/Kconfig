## kernel/msm-4.4/drivers/hwmon/nubia_sensors/Kconfig
```kconfig
################################################# SENROS START
menuconfig NUBIA_SENSORS
	tristate "NUBIA SENSORS ON"
	default n
	help
		nubia sensor
if NUBIA_SENSORS
config FEATURE_NUBIA_SENSORS_LOG_ON
	tristate "NUBIA SENSORS LOG ON"
	depends on NUBIA_SENSORS
	default n
	help
		If you want to enable the sensor log,
		then choose this config
################################################# PROX START
config NUBIA_SENSORS_PROX_PA224
	tristate "support litehole prox sensor driver"
	depends on NUBIA_SENSORS
	default n
	help
		nubia prox device

################################################# RGB START
config NUBIA_SENSORS_RGB_BH1745
	tristate "support rgb bh1745 driver"
	depends on NUBIA_SENSORS
	default n
	help
		nubia rgb device

################################################# HALL START
config NUBIA_SENSORS_HALL_DEVICE
	tristate "hall devicedriver"
	depends on NUBIA_SENSORS
	default n
	help
	  If you say yes here you get support for
	  hall device
################################################# IR REMOTE START
config NUBIA_SENSORS_IR_REMOTE_I_THREE
	tristate "I_THREE device driver"
	depends on NUBIA_SENSORS
	default n
	help
	  If you say yes here you get support for UEI's
	  IR Remote control i_three

################################################# VIBRATOR START
menuconfig NUBIA_SENSOR_VIBRATOR
	tristate "NUBIA VIBRATOR DEVICE"
	depends on NUBIA_SENSORS
	default n

source "drivers/hwmon/nubia_sensors/drv2605/Kconfig"

################################################# FINGER_PRINTER START
menuconfig NUBIA_SENSORS_FP
	tristate "NUBIA FP DEVICE"
	depends on NUBIA_SENSORS
	default n

if NUBIA_SENSORS_FP

config NUBIA_FP_AUTODETECT
	tristate "nubia fingerprint autodetect"
	depends on NUBIA_SENSORS_FP
	default n
	help
	  If you say yes here you, will enable fingerprint
	  autodetect function.


################################################# FINGER_PRINTER_FPC1020 START
source  drivers/hwmon/nubia_sensors/fpc1020/Kconfig
choice
        prompt "choose the FPC1020 device style"
        depends on NUBIA_SENSORS_FP_FPC1020
		default NUBIA_SENSORS_FP_FPC1020_PLATFORM
		help
		  FPC1020 need to select the work style

config NUBIA_SENSORS_FP_FPC1020_SPI
        bool "FPC1020 work as SPI device"
        help
          If you want FPC1020 work as SPI device, select it.

config NUBIA_SENSORS_FP_FPC1020_PLATFORM
        bool "FPC1020 work as PLATFORM device"
        help
          If you want FPC1020 work as PLATFORM device, select it.

endchoice
################################################# FINGER_PRINTER_FPC1020 END
################################################# FINGER_PRINTER_GF5216M START
source drivers/hwmon/nubia_sensors/gf5228/Kconfig
################################################# FINGER_PRINTER_GF5216M END
endif
################################################# FINGER_PRINTER END
endif
```

## kernel/msm-4.4/drivers/hwmon/nubia_sensors/drv2605/Kconfig
```kconfig
config DRV2605
	tristate "ti 2605 driver"
	default n
	help
	  This module is ti 2605 driver.
```

## kernel/msm-4.4/drivers/hwmon/nubia_sensors/gf5228/Kconfig
```kconfig
config NUBIA_SENSORS_FP_GF5228M_PLATFORM
	tristate "nubia sensors fp gf5228m"
	depends on NUBIA_SENSORS_FP
	default n
	help
	  This is the main file for fingerprint driver for gf5216m.
	  Say Y here if you have a gf5216m fingerprint connected
	  to your system.
```

## kernel/msm-4.4/drivers/nubia_hw_version/Kconfig
```kconfig
################nubia hw_version config start################
config NUBIA_HW_VERSION
	bool "NUBIA HW VERSION"
	default y
	help
	  NUBIA HW VERSION

config NUBIA_HW_VERSION_DEBUG
	bool "NUBIA HW VERSION DEBUG"
	depends on NUBIA_HW_VERSION
	default n
	help
		NUBIA HW VERSION DEBUG

config NUBIA_HW_VER_BY_ADC
	bool "NUBIA HW VER BY ADC"
	depends on NUBIA_HW_VERSION
	default n
	help
		NUBIA HW VER BY ADC

config NUBIA_HW_CONFIG_BY_GPIO
	bool "NUBIA HW CONFIG BY GPIO"
	depends on NUBIA_HW_VERSION
	default n
	help
		NUBIA HW CONFIG BY GPIO

config NUBIA_HW_GPIO_BY_PM
	bool "NUBIA_HW_GPIO_BY_PM"
	depends on NUBIA_HW_VERSION
	default n
	help
		NUBIA HW GPIO BY PM

config NUBIA_HW_CPU_SERIAL_NUM
	bool "NUBIA HW CPU SERIAL NUM"
	depends on NUBIA_HW_VERSION
	default y
	help
	  NUBIA HW CPU SERIAL NUM
```
